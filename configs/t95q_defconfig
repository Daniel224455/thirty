## configs/t95q_defconfig
```kconfig
CONFIG_SUNXI_DRAM_H616_LPDDR3=y
CONFIG_DRAM_CLK=648
CONFIG_DRAM_SUNXI_DX_ODT=0x6060606
CONFIG_DRAM_SUNXI_DX_DRI=0xd0d0d0d
CONFIG_DRAM_SUNXI_CA_DRI=0x1919
CONFIG_DRAM_SUNXI_ODT_EN=0x9988eeee
CONFIG_DRAM_SUNXI_TPR6=0x2fc08080
CONFIG_DRAM_SUNXI_TPR10=0x402f3379
CONFIG_DRAM_SUNXI_TPR11=0xd100b0f
CONFIG_DRAM_SUNXI_TPR12=0x11131113
```
